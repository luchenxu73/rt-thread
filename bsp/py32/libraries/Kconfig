## bsp/py32/libraries/Kconfig
```kconfig
config SOC_FAMILY_PY32
    bool

config SOC_SERIES_PY32F403
    bool
    select SOC_FAMILY_PY32
    select ARCH_ARM_CORTEX_M4

menu "On-chip peripheral drivers"

config BSP_USING_GPIO
    bool "Enable GPIO"
    select RT_USING_PIN
    default y
    help
        GPIO input, output, pull-up, pull-down and open-drain modes.
        External GPIO interrupts are not supported yet.

menuconfig BSP_USING_UART
    bool "Enable UART"
    select RT_USING_SERIAL
    default y
    help
        The PY32 UART driver uses Serial V1 with interrupt receive and
        polling transmit. DMA, transmit interrupts and hardware flow
        control are not supported yet.

if BSP_USING_UART

comment "Select Serial V1 in RT-Thread Components to enable UART instances"
    depends on !RT_USING_SERIAL_V1

config BSP_USING_UART1
    bool "Enable UART1"
    depends on RT_USING_SERIAL_V1

config BSP_USING_UART2
    bool "Enable UART2"
    depends on RT_USING_SERIAL_V1

endif

endmenu
```

## bsp/py32/py32f403_start_kit/board/Kconfig
```kconfig
menu "Hardware Drivers Config"

config BSP_USING_UART2
    depends on BSP_USING_UART && RT_USING_SERIAL_V1
    default y

choice
    prompt "Chip variant"
    default SOC_PY32F403xD
    help
        Flash size selection. It must match the fitted part: the selected
        symbol is passed to the vendor headers as PY32F403xB/xC/xD, and the
        linker script is fixed for 384 KiB (xD).

config SOC_PY32F403xB
    bool "PY32F403xB (128 KiB Flash, 64 KiB SRAM)"
    select SOC_SERIES_PY32F403

config SOC_PY32F403xC
    bool "PY32F403xC (256 KiB Flash, 64 KiB SRAM)"
    select SOC_SERIES_PY32F403

config SOC_PY32F403xD
    bool "PY32F403xD (384 KiB Flash, 64 KiB SRAM)"
    select SOC_SERIES_PY32F403

endchoice

config SOC_PY32F403
    bool
    default y
    select RT_USING_COMPONENTS_INIT
    select RT_USING_USER_MAIN

endmenu
```
